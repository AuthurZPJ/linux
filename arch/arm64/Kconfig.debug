## arch/arm64/Kconfig.debug
```kconfig
# SPDX-License-Identifier: GPL-2.0-only

config PID_IN_CONTEXTIDR
	bool "Write the current PID to the CONTEXTIDR register"
	help
	  Enabling this option causes the kernel to write the current PID to
	  the CONTEXTIDR register, at the expense of some additional
	  instructions during context switch. Say Y here only if you are
	  planning to use hardware trace tools with this kernel.

config DEBUG_EFI
	depends on EFI && DEBUG_INFO
	bool "UEFI debugging"
	help
	  Enable this option to include EFI specific debugging features into
	  the kernel that are only useful when using a debug build of the
	  UEFI firmware

config ARM64_RELOC_TEST
	depends on m
	tristate "Relocation testing module"

config ARM64_AMU_LATENCY
	depends on m
	depends on ARM64_AMU_EXTN
	tristate "AMU counter read / this_cpu_has_cap latency benchmark module"
	help
	  A loadable module that measures the per-operation cost of reading the
	  AMU core/constant counters (SYS_AMEVCNTR0_CORE_EL0 /
	  SYS_AMEVCNTR0_CONST_EL0) and of this_cpu_has_cap(ARM64_WORKAROUND_2457168).

	  It does not touch the AMU hot paths in topology.c; it only calls the
	  same primitives on demand. Say M to build it as a module, load it with
	  insmod and read the results from dmesg. If unsure, say N.

source "drivers/hwtracing/coresight/Kconfig"
```
